## board/TL3218X_EVK/Kconfig.board
```kconfig
choice TLK_BOARD_CHOICE

config TLK_BOARD_TL3218X_EVK
    bool "TL3218X_EVK"
    depends on TLK_SOC_TL3218X

endchoice

config TLK_BOARD
    default "TL3218X_EVK" if TLK_BOARD_TL3218X_EVK
```

## core/drivers/Kconfig.core
```kconfig
config TLK_CORE_TL321X
    bool

config TLK_CORE
    default "TL321X" if TLK_CORE_TL321X

orsource "soc/*/Kconfig.soc"
orsource "boards/*/Kconfig.board"
```
